## drivers/misc/mediatek/base/power/Kconfig
```kconfig
config MTK_CPU_FREQ
	bool "MTK CPU FREQ"
	default n
	---help---
	  This kernel config can be used to enable CPU FREQ.
	  When enable this option, CPU frequency and voltage will be
	  changed which will depended on CPU FREQ governor.
	  If unsure, say N.

config MTK_PTPOD
	bool "MTK PTPOD"
	default n
	---help---
	  This kernel config can be used to enable cpu PTPOD.
	  When enable this option, cpu voltage will be
	  changed which will depended on chip.
	  If unsure, say N.

config MTK_PTPOD_GPU
        bool "MTK PTPOD GPU"
        default n
        ---help---
          This kernel config can be used to enable gpu PTPOD.
          When enable this option, gpu voltage will be
          changed which will depended on chip.
          If unsure, say N.

config MTK_CPU_MSSV
	bool "MTK CPU MSSV SUPPORT"
	---help---
	  This kernel config can be used to enable cpu MSSV support.
	  MSSV means Mediatek Software System Validation.
	  When enable this option, cpu V/F get/set function will be enabled.
	  This config should be enabled with corresponding MCUPM setting.
	  If unsure, say N.

config MTK_CPU_KORO
	bool "MTK CPU KORO SUPPORT"
	---help---
	  This kernel config can be used to enable cpu KORO support.
	  When enable this option, system will keep cpus power on while reset.
	  This config should be enabled depend on platform.
	  If unsure, say N.

config MTK_STATIC_POWER
	bool "MTK STATIC POWER"
	default n
	---help---
	  This kernel config can be used to enable static power.
	  This information can provide power data to someone who
	  need it
	  If unsure, say N.

config MTK_UNIFY_POWER
	bool "MTK UNIFY POWER"
	default n
	---help---
	  This kernel config can be used to enable unified power table.
	  This table can provide power data and capacity to someone who
	  need it.
	  If unsure, say Y.

config MTK_SLBC
	bool "MTK SLBC"
	---help---
	  This kernel config can be used to enable SLBC. When enable
	  this option, we will use system buffer to improve performance
	  and power.
	  If unsure, say N.

config MTK_SLBC_MMSRAM
	bool "MTK SLBC use MMSRAM"
	select MTK_SLBC
	---help---
	  This kernel config can be used to enable SLBC MMSRAM. When enable
	  this option, we will use system buffer to improve performance
	  and power.
	  If unsure, say N.

config MTK_CM_MGR
	bool "MTK CM MGR"
	default n
	---help---
	  This kernel config can be used to enable CM MGR. When enable
	  this option, dram opp level will be changed which will depended
	  on power table.
	  If unsure, say N.

config MTK_SWPM
	bool "MTK SW Power Meter"
	default n
	---help---
	  This kernel config can be used to enable SW power meter. When enable
	  this option, user can turn on SW power meter and get average power
	  for each power rail for low power debugging.
	  If unsure, say N.

config MTK_QOS_FRAMEWORK
	bool "MTK QOS FRAMEWORK"
	---help---
	  This kernel config can be used to enable MTK QOS FRAMEWORK.
	  When enabling this option, BW Limiter and BW Bound Detector
	  will be enabled and set EMI hardware.
	  If unsure, say N.

config MTK_QOS_V1
	bool "MTK QOS Framework Ver 1.0"
	default y if MACH_MT6768
	---help---
	  This version support QOS ver 1.0 feature sets.
	  The dram opp could be controlled by the BW prediction.
	  It is also mapped with sspm qos v1.
	  If unsure, say N.

config MTK_QOS_V2
	bool "MTK QOS Framework Ver 2.0"
	default y if MACH_MT6785
	default y if MACH_MT6885
	default y if MACH_MT6873
	default y if MACH_MT6853
	default y if MACH_MT6893
	default y if MACH_MT6833
	default y if MACH_MT6877
	default y if MACH_MT6781
	select MTK_QOS_FRAMEWORK
	---help---
	  This version support QOS version 2.0 feature sets.
	  It supports BW prediction, BW bound detection, and BW limiter.
	  It is also mapped with sspm qos v2.
	  If unsure, say N.

menu "WMK patch toggles"

config WMK_PATCH_CPU_G75_UV30
	bool "WMK: MT6768 G75 CPU undervolt -30mV"
	default n
	---help---
	  Reduces the baseline voltage for all Cortex-G75 (big) cluster OPPs
	  by 30mV. This lowers active power consumption and heat during
	  intensive tasks. Requires a stable chip; if the device reboots
	  under load, disable this option.

config WMK_PATCH_CPU_G75_UV_STEP
	bool "WMK: MT6768 G75 CPU extra -6.25mV step (LL/CCI OPP0-12)"
	default n
	select WMK_PATCH_CPU_G75_UV30
	---help---
	  Applies an additional 6.25mV (one PMIC tick) reduction to the 
	  Little cluster (LL) and CCI interconnect for OPP levels 0 through 12.
	  This further optimizes power for background and mid-range 
	  interactive workloads on top of the base -30mV undervolt.
	  Selecting this will automatically enable the base -30mV undervolt.

config WMK_PATCH_GPU_DVFS_UV
	bool "WMK: MT6768 GPU DVFS undervolt"
	default n
	---help---
	  Applies a custom undervolt table to the Mali GPU DVFS states.
	  Reduces power draw during 3D rendering and UI composition by
	  lowering the voltage/frequency curve. Tested to provide ~5-10%
	  GPU power savings depending on load.

config WMK_PATCH_MTK_MENU_SCREEN_OFF_PREDICT
	bool "WMK: mtk_menu relax prediction when screen is off"
	select WMK_PATCH_SCHEDUTIL_SCREEN_OFF_RATE_LIMIT
	default n
	---help---
	  When the screen is off, the mtk_menu governor skips the 
	  typical-interval prediction limiter. This allows the system to
	  enter deep idle states (rgidle/MCDI) more aggressively during
	  standby, significantly reducing idle drain. Selecting this will
	  automatically enable the required screen-state notifier.

config WMK_PATCH_MCDI_ALL_CPU_IDLE_THD
	bool "WMK: MCDI all-CPU idle threshold 80%"
	default n
	---help---
	  Lowers the all-CPU idle ratio threshold from 85% to 80%.
	  This makes the MCDI (Multi-Core Deep Idle) governor more 
	  permissive, allowing deeper cluster-wide sleep states to be
	  reached even when some background residency remains. Best 
	  used in conjunction with other MCDI/idle window tweaks.

config WMK_PATCH_SCHEDUTIL_SCREEN_OFF_RATE_LIMIT
	bool "WMK: Schedutil screen-off up rate limit"
	default n
	---help---
	  Enables a Framebuffer notifier that detects when the screen is
	  turned off. During standby, it triples the schedutil 'up' rate
	  delay, preventing brief background bursts from immediately 
	  ramping the CPU frequency to maximum. Essential base for other
	  screen-off optimizations.

config WMK_PATCH_SCHEDTUNE_BOOST_HOLD
	bool "WMK: Reduce SchedTune boost hold time to 10ms"
	default n
	---help---
	  Reduces the SchedTune boost residency from the stock 50ms to 10ms.
	  This allows the CPU to drop frequency and release boost resources
	  much sooner after a task burst completes, saving active power
	  during jittery workloads like web browsing.

config WMK_PATCH_MCDI_IDLE_WINDOW
	bool "WMK: Reduce MCDI idle window to 100ms"
	default n
	---help---
	  Shortens the look-back window for all-CPU idle decisions from
	  500ms to 100ms. Allows the governor to react faster to idle 
	  opportunities, entering deep sleep states sooner after activity
	  stops.

config WMK_PATCH_MALI_SHADER_TIMEOUT
	bool "WMK: Increase Mali shader power-off timeout"
	default n
	---help---
	  Increases the shader core power-off delay from 800us to 1.6ms.
	  Prevents "shader thrashing" where the core is repeatedly powered 
	  on and off during light GL workloads, which is more energy-intensive
	  than simply keeping it powered for a slightly longer period.

config WMK_PATCH_SCHEDUTIL_SCREEN_OFF_IOWAIT_DISABLE
	bool "WMK: Disable schedutil iowait boost when screen is off"
	select WMK_PATCH_SCHEDUTIL_SCREEN_OFF_RATE_LIMIT
	default n
	---help---
	  Prevents background I/O operations (like media scanning or 
	  cloud sync) from triggering frequency boosts while the device
	  is in standby. This ensures the CPU stays at lower frequencies
	  during sleep, even if background services are active.

config WMK_PATCH_SCHEDUTIL_SCREEN_OFF_FAST_DOWN
	bool "WMK: Bypass down-rate limit when screen is off"
	select WMK_PATCH_SCHEDUTIL_SCREEN_OFF_RATE_LIMIT
	default n
	---help---
	  Unconditionally bypasses the down_rate_delay when the screen 
	  is off. This allows the CPU to drop to its minimum frequency 
	  the instant a background task completes, bypassing the 
	  wait-for-safety period usually required for UI smoothness.

config WMK_PATCH_SCHED_DYNAMIC_CAPACITY_MARGIN
	bool "WMK: Dynamically adjust capacity margin on screen state"
	select WMK_PATCH_SCHEDUTIL_SCREEN_OFF_RATE_LIMIT
	default n
	---help---
	  Adjusts schedutil frequency headroom based on screen state.
	  Screen-on uses 1.125x (reduced from 1.25x for active power savings).
	  Screen-off removes headroom entirely (1.0x) so the CPU runs at
	  the most efficient energy point for background loads.

config WMK_PATCH_RCU_FORCE_NORMAL
	bool "WMK: Force normal RCU grace periods (battery saver)"
	default n
	---help---
	  Disables "expedited" RCU grace periods which use frequent
	  Inter-Processor Interrupts (IPIs) to wake all CPUs. Reverting
	  to normal grace periods significantly reduces CPU wake-up
	  overhead and active power consumption.

config WMK_PATCH_SCHED_INCREASE_MIGRATION_COST
	bool "WMK: Increase CFS task migration cost"
	default n
	---help---
	  Raises the minimum cost to migrate a task between CPUs from
	  33us to 500us. Discourages the scheduler from moving tasks 
	  across clusters (LITTLE <-> big) for trivial loads, keeping 
	  big cores asleep longer and reducing cache-bouncing overhead.

config WMK_PATCH_MALI_R54P2_DEFER_POWER_DOWN
	bool "WMK: Backport r54p2 GPU deferred power-down on runtime suspend"
	depends on MTK_GPU_SUPPORT
	default n
	---help---
	  Backports a critical stability and power fix from Mali r54p2.
	  If the GPU becomes active during a runtime suspend request, it
	  defers the power-down instead of forcing a regulator cut. 
	  Prevents L2/MCU state machine warnings and expensive HW 
	  re-initializations during rapid sleep/wake cycles.

config WMK_PATCH_TOUCH_BOOST_OPTIMIZE
zibool "WMK: Reduce touch boost target from 1183MHz to 900MHz"
zidefault n
zi---help---
zi  Lowers the CPU frequency target set on every touch event from
zi  1183MHz to 900MHz. The stock value causes unnecessary voltage
zi  and frequency spikes during scrolling and tapping. 900MHz
zi  provides adequate responsiveness while reducing active power.

endmenu
```
